## arch/arm/mach-s5p4418/Kconfig
```kconfig
if ARCH_S5P4418

choice
  prompt "S5P4418 board select"
  optional

config TARGET_NANOPI2_FIRE
  bool "Friendly ARM NANOPI2 Fire Board"
  select SUPPORT_SPL
  select BOARD_EARLY_INIT_F

endchoice

config SYS_SOC
  default "s5p4418"

source "board/samsung/nanopi2-fire/Kconfig"

endif
```

## board/samsung/nanopi2-fire/Kconfig
```kconfig
if TARGET_NANOPI2_FIRE

config SYS_BOARD
  default "nanopi2-fire"

config SYS_VENDOR
  default "samsung"

config SYS_CONFIG_NAME
  default "nanopi2-fire"

endif
```

## configs/nanopi2_fire_defconfig
```kconfig
CONFIG_ARM=y
CONFIG_ARCH_S5P4418=y
CONFIG_TARGET_NANOPI2_FIRE=y
CONFIG_CMD_MMC=y
CONFIG_DM=y
CONFIG_DM_SERIAL=y
CONFIG_DM_MMC=y
CONFIG_MMC_DW=y
CONFIG_SYS_MALLOC_SIMPLE=y
CONFIG_SYS_MALLOC_F_LEN=0x800
CONFIG_MMC_DW_S5P4418=y
CONFIG_ENABLE_ARM_SOC_BOOT0_HOOK=y
CONFIG_OF_CONTROL=y
CONFIG_SPL=y
CONFIG_SPL_DM=y
CONFIG_SPL_SERIAL_SUPPORT=y
CONFIG_SPL_MMC_SUPPORT=y
CONFIG_SPL_DM_SERIAL=y
CONFIG_SPL_DM_MMC=y
CONFIG_SPL_LIBCOMMON_SUPPORT=y
CONFIG_SPL_LIBGENERIC_SUPPORT=y
CONFIG_USE_TINY_PRINTF=y
CONFIG_PL01X_SERIAL=y
CONFIG_DEBUG_UART=y
CONFIG_DEBUG_UART_PL011=y
CONFIG_DEBUG_UART_BASE=0xc00a1000
CONFIG_DEBUG_UART_CLOCK=50000000
CONFIG_DEBUG_UART_BOARD_INIT=y
CONFIG_DEFAULT_DEVICE_TREE="s5p4418_nanopi2"
# CONFIG_CMD_IMLS is not set
# CONFIG_CMD_BDI is not set
# CONFIG_CMD_IMI is not set
# CONFIG_CMD_FPGA is not set
# CONFIG_CMD_FLASH is not set
# CONFIG_CMD_LOADS is not set
# CONFIG_CMD_USB is not set
# CONFIG_CMD_NFS is not set
# CONFIG_CMD_NET is not set
# CONFIG_CMD_ELF is not set
# CONFIG_CMD_GO is not set
# CONFIG_CMD_XIMG is not set
# CONFIG_NET is not set
```
